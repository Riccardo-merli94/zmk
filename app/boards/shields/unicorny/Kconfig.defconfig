## app/boards/shields/unicorny/Kconfig.defconfig
```kconfig
# Copyright (c) 2020 The ZMK Contributors
# SPDX-License-Identifier: MIT

if SHIELD_UNICORNY

config ZMK_KEYBOARD_NAME
    default "Unicorny"

endif
```
